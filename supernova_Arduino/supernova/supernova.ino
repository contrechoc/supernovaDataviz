
int arrayLength = 206;
int timeDelayTotal = 0;

char superNova[] = 
{

  3, 1, 
  4, 1, 
  0, 2, 
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  0, 178, 
};

void setup(){
  for (int i=5; i<10; i++)
  {
    pinMode(i, OUTPUT);
    digitalWrite(i, HIGH);
  }
  delay(1000);
 for (int i=5; i<10; i++)
  {
    digitalWrite(i, LOW);
  }
  Serial.begin(9600);
}

void loop(){

  timeDelayTotal = 0;
  for ( int i=0; i< arrayLength; i+=2){
   
    int zone = superNova[i];
    int timeD = superNova[i+1];
    int pinNum = 0;
    if (zone == 0 ) pinNum = 6;
    if (zone == 1 ) pinNum = 5;
    if (zone == 2 ) pinNum = 8;
    if (zone == 3 ) pinNum = 7;
    if (zone == 4 ) pinNum = 9;
    
     Serial.print(i);
        Serial.print(" ");
           Serial.print(zone);
              Serial.print(" ");
        Serial.println(timeD);

    if ( timeD < timeDelayTotal ) timeD = timeDelayTotal;

    digitalWrite( pinNum, HIGH);
    delay(50);
    digitalWrite( pinNum, LOW);
    
    delay( (timeD - timeDelayTotal)*1000 + 100);
    timeDelayTotal = timeD;
  }

  for (int i=5; i<10; i++)
  {
    digitalWrite(i, HIGH);
  }
  delay(1000);
 for (int i=5; i<10; i++)
  {
    digitalWrite(i, LOW);
  }
 delay(1000);


}


